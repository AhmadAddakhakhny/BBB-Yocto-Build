## layers/meta-bbb/conf/distro/bbb.conf
```bitbake
# bbb.conf - custom distro for BeagleBone Black

require conf/distro/poky.conf

DISTRO = "bbb"
DISTRO_NAME = "BeagleBone Black Linux"
DISTRO_VERSION = "1.0.0"

# Ensure systemd + usrmerge work properly
DISTRO_FEATURES:append = " systemd usrmerge"

VIRTUAL-RUNTIME_init_manager = "systemd"
VIRTUAL-RUNTIME_initscripts = "systemd-compat-units"
VIRTUAL-RUNTIME_dev_manager = "systemd"
VIRTUAL-RUNTIME_login_manager = "shadow-base"

# SDK compatibility
SDKIMAGE_FEATURES:append = " dev-pkgs dbg-pkgs staticdev-pkgs"

# Preferred providers (optional)
PREFERRED_PROVIDER_virtual/bootloader = "u-boot-ti-staging"
```

## layers/meta-bbb/conf/layer.conf
```bitbake
# We have a conf and classes directory, add to BBPATH
BBPATH .= ":${LAYERDIR}"

# We have recipes-* directories, add to BBFILES
BBFILES += "${LAYERDIR}/recipes-*/*/*.bb \
            ${LAYERDIR}/recipes-*/*/*.bbappend"

BBFILE_COLLECTIONS += "bbb"
BBFILE_PATTERN_bbb = "^${LAYERDIR}/"
BBFILE_PRIORITY_bbb = "20"

LAYERSERIES_COMPAT_bbb = "scarthgap"
LAYERVERSION_bbb = "1"
LAYERDEPENDS_bbb = "core meta-beagle"
```
